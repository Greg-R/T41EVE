/*
T41EVE Copyright 2026 Gregory Raven

This file is part of T41EVE.

T41EVE is free software: you can redistribute it and/or modify it under the terms of the GNU General Public License as published by the Free Software Foundation, either version 3 of the License, or (at your option) any later version.

T41EVE is distributed in the hope that it will be useful, but WITHOUT ANY WARRANTY; without even the implied warranty of MERCHANTABILITY or FITNESS FOR A PARTICULAR PURPOSE. See the GNU General Public License for more details.

You should have received a copy of the GNU General Public License along with T41EVE. If not, see <https://www.gnu.org/licenses/>.

  This comment block must appear in the load page (e.g., main() or setup()) in any source code
  that uses code presented as whole or part of the T41-EP source code.

  (c) Frank Dziock, DD4WH, 2020_05_8
  "TEENSY CONVOLUTION SDR" substantially modified by Jack Purdum, W8TEE, and Al Peter, AC8GY

  This software is made available under the GNU GPLv3 license agreement. If commercial use of this
  software is planned, we would appreciate it if the interested parties contact Jack Purdum, W8TEE, 
  and Al Peter, AC8GY.

  Any and all other uses, written or implied, by the GPLv3 license are forbidden without written 
  permission from from Jack Purdum, W8TEE, and Al Peter, AC8GY.
*/

// Most of the functions which follow are for control of the Si5351 PLL module.

#include "SDT.h"

uint64_t Clk0SetFreq = 0;
uint64_t Clk1SetFreq = 0;
uint64_t Clk2SetFreq = 0;

#define MASTER_CLK_MULT_RX 2
#define MASTER_CLK_MULT_TX 2

/*****
  Purpose: A special variant of SetFreq() used only for calibration.

  Parameter list:
    void

  Return value;
    void

  CAUTION: SI5351_FREQ_MULT is set in the si5253.h header file and is 100UL
*****/
void SetFreqCal(int calFreqShift) {                            // July 7 2023 KF5N
  uint32_t IFFreq = SR[SampleRate].rate / 4;                   // IF (intermediate) frequency
  int cwFreqOffset = (ConfigData.CWOffset + 6) * 24000 / 256;  // Calculate the CW offset based on user selected CW offset frequency.
  // The SSB LO frequency is always the same as the displayed transmit frequency.
  // The CW LO frequency must be shifted by 750 Hz due to the way the CW carrier is generated by a quadrature tone.
  if (bands.bands[ConfigData.currentBand].sideband == Sideband::LOWER)
    Clk2SetFreq = (((TxRxFreq + cwFreqOffset + calFreqShift) * SI5351_FREQ_MULT)) * MASTER_CLK_MULT_TX;  // AFP 09-27-22;  KF5N flip CWFreqShift, sign originally minus
  if (bands.bands[ConfigData.currentBand].sideband == Sideband::UPPER)
    Clk2SetFreq = (((TxRxFreq - cwFreqOffset + calFreqShift) * SI5351_FREQ_MULT)) * MASTER_CLK_MULT_TX;  // AFP 10-01-22; KF5N flip CWFreqShift
  //  The receive LO frequency is not dependent on mode or sideband. CW frequency shift is done in DSP code.
  Clk0SetFreq = ((ConfigData.centerFreq * SI5351_FREQ_MULT) + IFFreq * SI5351_FREQ_MULT) * MASTER_CLK_MULT_RX;

  //  Set and enable both RX and TX local oscillator outputs.
  si5351.set_freq(Clk0SetFreq, SI5351_CLK0);
  si5351.set_freq(Clk2SetFreq, SI5351_CLK2);
  si5351.output_enable(SI5351_CLK0, 1);
  si5351.output_enable(SI5351_CLK2, 1);
}


/*****
  Purpose: SetFrequency

  Parameter list:
    void

  Return value;
    void

  CAUTION: SI5351_FREQ_MULT is set in the si5253.h header file and is 100UL
*****/
void SetFreq() {                                               //AFP 09-22-22   Revised July 7 KF5N
  uint32_t IFFreq = SR[SampleRate].rate / 4;                   // IF (intermediate) frequency
  int cwFreqOffset = (ConfigData.CWOffset + 6) * 24000 / 256;  // Calculate the CW offset based on user selected CW offset frequency.
  // The SSB LO frequency is always the same as the displayed transmit frequency.
  // The CW LOT frequency must be shifted by 750 Hz due to the way the CW carrier is generated by a quadrature tone.
  if (radioState == RadioState::SSB_TRANSMIT_STATE or radioState == RadioState::FT8_TRANSMIT_STATE or radioState == RadioState::SSB_IM3TEST_STATE) {
    Clk2SetFreq = (TxRxFreq * SI5351_FREQ_MULT) * MASTER_CLK_MULT_TX;  // AFP 09-27-22
  } else if (radioState == RadioState::CW_TRANSMIT_STRAIGHT_STATE or radioState == RadioState::CW_TRANSMIT_KEYER_STATE) {
    if (bands.bands[ConfigData.currentBand].sideband == Sideband::LOWER) {
      Clk2SetFreq = (((TxRxFreq + cwFreqOffset) * SI5351_FREQ_MULT)) * MASTER_CLK_MULT_TX;  // AFP 09-27-22;  KF5N flip CWFreqShift, sign originally minus
    } else {
      if (bands.bands[ConfigData.currentBand].sideband == Sideband::UPPER) {
        Clk2SetFreq = (((TxRxFreq - cwFreqOffset) * SI5351_FREQ_MULT)) * MASTER_CLK_MULT_TX;  // AFP 10-01-22; KF5N flip CWFreqShift, sign originally plus
      }
    }
  }

  //  The receive LO frequency is not dependent on mode or sideband.  CW frequency shift is done in DSP code.
  Clk0SetFreq = ((ConfigData.centerFreq * SI5351_FREQ_MULT) + IFFreq * SI5351_FREQ_MULT) * MASTER_CLK_MULT_RX;

  if (radioState == RadioState::SSB_RECEIVE_STATE or radioState == RadioState::FT8_RECEIVE_STATE or radioState == RadioState::CW_RECEIVE_STATE or radioState == RadioState::AM_RECEIVE_STATE or radioState == RadioState::SAM_RECEIVE_STATE) {  //  Receive state
    si5351.set_freq(Clk0SetFreq, SI5351_CLK0);
    si5351.output_enable(SI5351_CLK2, 0);  // CLK2 (transmit) off during receive to prevent birdies
    si5351.output_enable(SI5351_CLK0, 1);
  }

  if (radioState == RadioState::SSB_TRANSMIT_STATE or radioState == RadioState::SSB_IM3TEST_STATE or radioState == RadioState::FT8_TRANSMIT_STATE or radioState == RadioState::CW_TRANSMIT_STRAIGHT_STATE or radioState == RadioState::CW_TRANSMIT_KEYER_STATE) {  // Transmit state
    si5351.set_freq(Clk2SetFreq, SI5351_CLK2);
    si5351.output_enable(SI5351_CLK0, 0);  // CLK0 (receive) off during transmit to prevent spurious outputs
    si5351.output_enable(SI5351_CLK2, 1);
  }
}


/***** //AFP 10-11-22 all new
  Purpose:  Reset tuning to center

  Parameter list:
  void

  Return value;
  void
*****/
void ResetTuning() {
  currentFreq = ConfigData.centerFreq + NCOFreq;  // currentFreqA changed to currentFreq.  KF5N August 7, 2023
  NCOFreq = 0;
  ConfigData.centerFreq = TxRxFreq = currentFreq;  //AFP 10-28-22  // currentFreqA changed to currentFreq.  KF5N August 7, 2023
  SetFreq();  // For new tuning scheme.  KF5N July 22, 2023
}


/*****
  Purpose: Purpose is to set VFOA to receive frequency and VFOB to the transmit frequency.
           This not currently working, and it will be implemented in a future release.

  Parameter list:
    void

  Return value;
    int           the offset as an int

  CAUTION: SI5351_FREQ_MULT is set in the si5253.h header file and is 100UL
*****
int DoSplitVFO() {
  char freqBuffer[15];
  MenuSelect menu;
  long chunk = SPLIT_INCREMENT;
  long splitOffset;

  tft.drawRect(INFORMATION_WINDOW_X - 10, INFORMATION_WINDOW_Y - 2, 260, 200, RA8875_MAGENTA);
  tft.fillRect(INFORMATION_WINDOW_X - 8, INFORMATION_WINDOW_Y, 250, 185, RA8875_BLACK);  // Clear volume field
  tft.setFontScale((enum RA8875tsize)1);
  tft.setCursor(INFORMATION_WINDOW_X + 10, INFORMATION_WINDOW_Y + 5);
  tft.print("xmit offset: ");

  splitOffset = chunk;  // Set starting offset to 500Hz
  tft.setTextColor(RA8875_GREEN);
  tft.setCursor(INFORMATION_WINDOW_X + 60, INFORMATION_WINDOW_Y + 90);
  tft.print(splitOffset);
  tft.print("Hz  ");

  while (true) {
    if (filterEncoderMove != 0) {  // Changed encoder?
      splitOffset += filterEncoderMove * chunk;
      tft.fillRect(INFORMATION_WINDOW_X + 60, INFORMATION_WINDOW_Y + 90, 150, 50, RA8875_BLACK);
      tft.setCursor(INFORMATION_WINDOW_X + 60, INFORMATION_WINDOW_Y + 90);
      tft.print(splitOffset);
      tft.print("Hz  ");
    }
    filterEncoderMove = 0L;

    menu = readButton();
    if (menu == MenuSelect::MENU_OPTION_SELECT) {  // Make a choice??
      Clk1SetFreq += splitOffset;                  // New transmit frequency // AFP 09-27-22
                                                   //      UpdateInfoWindow();
      filterEncoderMove = 0L;
      break;
    }
  }
  ConfigData.currentFreqB = ConfigData.currentFreqA + splitOffset;
  display.FormatFrequency(ConfigData.currentFreqB, freqBuffer);
  tft.fillRect(FREQUENCY_X_SPLIT, FREQUENCY_Y - 12, VFOB_PIXEL_LENGTH, FREQUENCY_PIXEL_HI, RA8875_BLACK);
  tft.setCursor(FREQUENCY_X_SPLIT, FREQUENCY_Y);
////  tft.setFont(&FreeMonoBold24pt7b);
  tft.setTextColor(RA8875_GREEN);
  tft.print(freqBuffer);  // Show VFO_A

////  tft.setFont(&FreeMonoBold18pt7b);
  display.FormatFrequency(ConfigData.currentFreqA, freqBuffer);
  tft.setTextColor(RA8875_LIGHT_GREY);
  tft.setCursor(FREQUENCY_X, FREQUENCY_Y + 6);
  tft.print(freqBuffer);  // Show VFO_A

  tft.useLayers(1);  //mainly used to turn on layers!
  tft.layerEffect(OR);
  tft.writeTo(L2);
  tft.clearMemory();
  tft.writeTo(L1);

////  tft.setFont(&FreeMono9pt7b);
  tft.setTextColor(RA8875_RED);
  tft.setCursor(176 + 180, 102 + 6);
  tft.print("Split Active");

  tft.setFontDefault();
  return (int)splitOffset;  // Can be +/-
}
*/


/*****
  Purpose: Reset the flip-flops in the QSD2/QSE2 quadrature generators.

  Parameter list:
    void

  Return value;
    void
*****/
void ResetFlipFlops() {
  // Toggle GPO0 low momentarily to reset the divide-by-2 flop-flops.
  // GPO0 is held high during normal operation.
  si5351.output_enable(SI5351_CLK2, 0);
  si5351.output_enable(SI5351_CLK0, 0);
  digitalWrite(0, LOW);  // Reset low.
  delay(500);
  digitalWrite(0, HIGH);  // Normal operation high.
  delay(500);
}
